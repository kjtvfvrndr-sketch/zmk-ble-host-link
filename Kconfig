## dts/bindings/behaviors/zmk,behavior-ble-host-link.yaml
```yaml
description: |
  The parameters of the Bluetooth link to the computer, per BLE profile, and
  the pointer report interval that goes with them. See README.md.

compatible: "zmk,behavior-ble-host-link"

include: two_param.yaml

properties:
  ble-host-interval-presets:
    type: array
    required: true
    description: |
      Host intervals BLE_HOST_INTERVAL_NEXT / _PREV step through: from the
      interval in effect to the next larger / smaller one, round the list.
      Exact intervals in Bluetooth units of 1.25 ms (6 = 7.5 ms, 12 = 15 ms);
      no AUTO here (BLE_HOST_INTERVAL_SET BLE_HOST_INTERVAL_AUTO hands the
      interval back).
  ble-host-latency-presets:
    type: array
    required: true
    description: |
      Host latencies BLE_HOST_LATENCY_NEXT / _PREV step through the same
      way, in connection events; no AUTO here.
  ball-ble-report-presets:
    type: array
    required: true
    description: |
      Pointer report intervals over BLE BALL_BLE_REPORT_NEXT / _PREV step
      through the same way, in ms; no AUTO here.
```
